## build/conf/bblayers.conf
```bitbake
# POKY_BBLAYERS_CONF_VERSION is increased each time build/conf/bblayers.conf
# changes incompatibly
POKY_BBLAYERS_CONF_VERSION = "2"

BBPATH = "${TOPDIR}"
BBFILES ?= ""

BBLAYERS ?= " \
  /home/vsp/workspaces/06.projects/plabs_go001/poky/meta \
  /home/vsp/workspaces/06.projects/plabs_go001/poky/meta-poky \
  /home/vsp/workspaces/06.projects/plabs_go001/poky/meta-yocto-bsp \
  /home/vsp/workspaces/06.projects/plabs_go001/meta-go001 \
  /home/vsp/workspaces/06.projects/plabs_go001/meta-openembedded/meta-oe \
  /home/vsp/workspaces/06.projects/plabs_go001/meta-openembedded/meta-initramfs \
  /home/vsp/workspaces/06.projects/plabs_go001/meta-openembedded/meta-python \
  /home/vsp/workspaces/06.projects/plabs_go001/meta-openembedded/meta-multimedia \
  /home/vsp/workspaces/06.projects/plabs_go001/meta-openembedded/meta-networking \
  /home/vsp/workspaces/06.projects/plabs_go001/meta-openembedded/meta-filesystems \
  /home/vsp/workspaces/06.projects/plabs_go001/meta-st-stm32mp \
  /home/vsp/workspaces/06.projects/plabs_go001/meta-wayland \
  "
```
